## main/Kconfig.projbuild
```kconfig
menu "esp32-i2c-error-1503 Configuration"

config I2C_MASTER_SCL_GPIO
    int "I2C Master SCL GPIO number"
    range 0 34
    default 19
    help
        GPIO number (IOxx) for I2C SCL.

        Some GPIOs are used for other purposes (flash connections, etc.) and cannot be used.

        GPIOs 35-39 are input-only so cannot be used to drive the I2C bus.

config I2C_MASTER_SDA_GPIO
    int "I2C Master SDA GPIO number"
    range 0 34
    default 18
    help
        GPIO number (IOxx) for I2C SDA.

        Some GPIOs are used for other purposes (flash connections, etc.) and cannot be used.

        GPIOs 35-39 are input-only so cannot be used to drive the I2C bus.

endmenu
```
